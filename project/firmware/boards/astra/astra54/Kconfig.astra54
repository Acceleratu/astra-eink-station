## project/firmware/boards/astra/astra54/Kconfig.astra54
```kconfig
config BOARD_ASTRA54
	select SOC_NRF54L15_CPUAPP if BOARD_ASTRA54_NRF54L15_CPUAPP
```

## project/firmware/boards/astra/astra54/astra54_nrf54l15_cpuapp_defconfig
```kconfig
CONFIG_GPIO=y
CONFIG_ARM_MPU=y
CONFIG_USE_DT_CODE_PARTITION=y
CONFIG_CLOCK_CONTROL_NRF_K32SRC_XTAL=y
```

## project/firmware/boards/astra/astra54/board.yml
```yaml
board:
  name: astra54
  full_name: Astra e-paper weather station
  vendor: others
  socs:
    - name: nrf54l15
```
